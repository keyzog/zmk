## app/boards/shields/kapl/Kconfig.defconfig
```kconfig
if SHIELD_KAPL_LEFT

config ZMK_KEYBOARD_NAME
	default "Kapl"

config ZMK_SPLIT_BLE_ROLE_CENTRAL
	default y

endif

if SHIELD_KAPL_LEFT || SHIELD_KAPL_RIGHT

config ZMK_SPLIT
	default y

endif
```

## app/boards/shields/kapl/Kconfig.shield
```kconfig
config SHIELD_KAPL_LEFT
	def_bool $(shields_list_contains,kapl_left)

config SHIELD_KAPL_RIGHT
	def_bool $(shields_list_contains,kapl_right)
```
